## drivers/media/platform/antmicro/Kconfig
```kconfig
config ANTMICRO_HISPI_INTERFACE
        tristate "Antmicro HiSpi interface support"
        depends on V4L_PLATFORM_DRIVERS
        default m
        ---help---
          HiSpi interface support driver.

config ANTMICRO_STEREO_VISION
        tristate "Antmicro stereo vision ipcore support"
        default m
        ---help---
          Stereo Vision IPCore driver.
```
